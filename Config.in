## Config.in
```kconfig
 mainmenu "GL.iNet(luochongjun@gl-inet.com)"

#config MODULES
#    modules
#    bool
#    default y

source "tmp/tmpglboard.in"

choice
    prompt "Select the download source location"

config DOWNLOAD_FROM_AWS
            bool "download from Amazon Aws"
            help
              Download imagebuilder and SDK from Amazon Aws

config DOWNLOAD_FROM_ALIYUN
            bool "download from China Aliyun"
            help
              Download imagebuilder and SDK from China Aliyun
endchoice

menu "Configure customer version information"

  config CUSTOMER_VERSION_NUMBER
  	string
    prompt "Specified version number"
	  help
	    "This string will be placed in the /etc/glversion file, and the value will be displayed on the UI"

  config CUSTOMER_VERSION_TYPE
  	string
    default "release"
    prompt "Specified version type"
	  help
	    "This string will be placed in the /etc/version.type file, and the value will be displayed on the UI"

  config CUSTOMER_VERSION_RELEASENOTES
  	string
    prompt "Specified version release notes"
    default "Firmware generated using glbuilder, powered by GL.iNet(luochongjun@gl-inet.com)"
	  help
	    "These contents are appended to the firmware metadata data as releasenote, Please mainly do not use single and double quotation marks"
endmenu

 menu "Global option"
  config NOT_USE_REMOTE_REPO
  	bool
    default y
    prompt "Imagebuilder do not use remote repository"
	  help
	    "Do not use remote repository,avoid some priority issues."

  config SIGNATURE_KEY_PATH
  	string
    prompt "Specified signature key path"
	  help
	    "TThe signature key identifies the producer of the firmware and is used to sign packages"
endmenu

config CUSTOMER_BUILDIN_PACKAGES
	string
	prompt "Customer build-in packages"
	help
	  "List of packages that the customer needs to package into the firmware, separate multiple packages using Spaces, You can also use '-' to exclude packets"


source "tmp/.customer-package.in"
source "Config-sdk-common.in"
```
